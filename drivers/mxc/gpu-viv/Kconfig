## drivers/mxc/gpu-viv/Kconfig
```kconfig
menu "MXC Vivante GPU support"
	depends on SOC_IMX6

config MXC_GPU_VIV
	tristate "MXC Vivante GPU support"
	select THERMAL
	select DEVICE_THERMAL
	---help---
         Say Y to get the GPU driver support.

endmenu
```

## drivers/mxc/mipi/Kconfig
```kconfig
#
# MIPI configuration
#

menu "MXC MIPI Support"

config MXC_MIPI_CSI2
#	tristate "MIPI CSI2 support"
	tristate
	depends on SOC_IMX6Q
	default n
	---help---
	Say Y to get the MIPI CSI2 support.

endmenu
```

## drivers/net/dsa/microchip/Kconfig
```kconfig
menuconfig MICROCHIP_KSZ
	tristate "Microchip KSZ series switch support"
	depends on NET_DSA
	select NET_DSA_TAG_KSZ
	help
	  This driver adds support for Microchip KSZ switch chips.

config MICROCHIP_KSZ_SPI_DRIVER
	tristate "KSZ series SPI connected switch driver"
	depends on MICROCHIP_KSZ && SPI
	help
	  Select to enable support for registering switches configured through SPI.

config MICROCHIP_KSZ_I2C_DRIVER
	tristate "KSZ series I2C connected switch driver"
	depends on MICROCHIP_KSZ && I2C
	help
	  Select to enable support for registering switches configured through I2C.
```
