// SPDX-License-Identifier: (GPL-2.0-or-later OR MIT)
/*
 * Copyright 2018 TQ Systems GmbH
 * Author: Markus Niebel <Markus.Niebel@tq-group.com>
 */
/ {
	model = "TQ Systems i.MX6 UltraLite Baseboard - Connectivity DT";
};

&iomuxc {
	pinctrl-names = "default";
	pinctrl-0 = <&pinctrl_hog>;

	pinctrl_hog: hoggrp {
		fsl,pins = <
			MX6UL_PAD_LCD_CLK__GPIO3_IO00		0x3098
			MX6UL_PAD_LCD_ENABLE__GPIO3_IO01	0x3098
			MX6UL_PAD_LCD_HSYNC__GPIO3_IO02		0x3098
			MX6UL_PAD_LCD_VSYNC__GPIO3_IO03		0x3098
			MX6UL_PAD_LCD_RESET__GPIO3_IO04		0x3098
			MX6UL_PAD_LCD_DATA00__GPIO3_IO05	0x3098
			MX6UL_PAD_LCD_DATA01__GPIO3_IO06	0x3098
			MX6UL_PAD_LCD_DATA02__GPIO3_IO07	0x3098
			MX6UL_PAD_LCD_DATA03__GPIO3_IO08	0x3098
			MX6UL_PAD_LCD_DATA04__GPIO3_IO09	0x3098
			MX6UL_PAD_LCD_DATA05__GPIO3_IO10	0x3098
			MX6UL_PAD_LCD_DATA06__GPIO3_IO11	0x3098
			MX6UL_PAD_LCD_DATA07__GPIO3_IO12	0x3098
			MX6UL_PAD_LCD_DATA08__GPIO3_IO13	0x3098
			MX6UL_PAD_LCD_DATA09__GPIO3_IO14	0x3098
			MX6UL_PAD_LCD_DATA10__GPIO3_IO15	0x3098
			MX6UL_PAD_LCD_DATA11__GPIO3_IO16	0x3098
			MX6UL_PAD_LCD_DATA12__GPIO3_IO17	0x3098
			MX6UL_PAD_LCD_DATA13__GPIO3_IO18	0x3098
			MX6UL_PAD_LCD_DATA14__GPIO3_IO19	0x3098
			MX6UL_PAD_LCD_DATA15__GPIO3_IO20	0x3098
			MX6UL_PAD_LCD_DATA16__GPIO3_IO21	0x3098
			MX6UL_PAD_LCD_DATA17__GPIO3_IO22	0x3098
			MX6UL_PAD_LCD_DATA18__GPIO3_IO23	0x3098
			MX6UL_PAD_LCD_DATA19__GPIO3_IO24	0x3098
			MX6UL_PAD_LCD_DATA20__GPIO3_IO25	0x3098
			MX6UL_PAD_LCD_DATA21__GPIO3_IO26	0x3098
			MX6UL_PAD_LCD_DATA22__GPIO3_IO27	0x3098
			MX6UL_PAD_LCD_DATA23__GPIO3_IO28	0x3098
		>;
	};
};
