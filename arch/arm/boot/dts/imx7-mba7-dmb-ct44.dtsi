// SPDX-License-Identifier: (GPL-2.0-or-later OR MIT)
/*
 * Copyright 2016-2019 TQ Systems GmbH
 * Author: Marco Felsch
 *         Markus Niebel <Markus.Niebel@tq-group.com>
 */

&backlight {
	pwms = <&pwm1 0 20000 0>; /* 50 kHz */
	brightness-levels = <0 1 4 8 16 32 64 128 255>;
	default-brightness-level = <8>;
	status = "okay";
};

&lcdif {
	status = "okay";
};

&panel {
	compatible = "dmb,s070swv29hg_dc44";
};

&polytouch {
	gain = <20>;

	touchscreen-size-x = <800>;
	touchscreen-size-y = <480>;

	status = "okay";
};
