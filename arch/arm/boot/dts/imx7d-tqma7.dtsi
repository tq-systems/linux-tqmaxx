// SPDX-License-Identifier: GPL-2.0+ OR MIT
/*
 * Copyright (C) 2016 - 2019 TQ Systems GmbH
 * Author: Markus Niebel <Markus.Niebel@tq-group.com>
 */

#include "imx7d.dtsi"
#include "imx7-tqma7.dtsi"
