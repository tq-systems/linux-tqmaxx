// SPDX-License-Identifier: (GPL-2.0-or-later OR MIT)
/*
 * Copyright 2018 TQ-Systems GmbH
 * Author: Markus Niebel <Markus.Niebel@tq-group.com>
 */

/dts-v1/;

#include <dt-bindings/input/input.h>
#include "imx6ul-tqma6ulx.dtsi"
#include "mba6ul-common.dtsi"

/ {
	model = "TQ-Systems TQMa6ULx SoM on MBa6ULx board";
	compatible = "tq,imx6ul-mba6ulx", "tq,imx6ul-tqma6ul2", "fsl,imx6ul";
};
