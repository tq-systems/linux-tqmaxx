// SPDX-License-Identifier: GPL-2.0-only
/*
 * Copyright (c) 2018-2023 TQ-Systems GmbH <linux@ew.tq-group.com>,
 * D-82229 Seefeld, Germany.
 * Author: Markus Niebel <Markus.Niebel@tq-group.com>
 */

#include "imx6q-mba6a.dts"
#include "imx6qdl-mba6-lvds-g133han01.dtsi"
