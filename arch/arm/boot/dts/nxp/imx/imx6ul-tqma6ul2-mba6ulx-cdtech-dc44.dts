// SPDX-License-Identifier: (GPL-2.0-or-later OR MIT)
/*
 * Copyright (c) 2018-2023 TQ-Systems GmbH <linux@ew.tq-group.com>,
 * D-82229 Seefeld, Germany.
 * Author: Markus Niebel <Markus.Niebel@tq-group.com>
 */

#include "imx6ul-tqma6ul2-mba6ulx.dts"
#include "mba6ulx-lcdif.dtsi"
#include "mba6ulx-cdtech-dc44.dtsi"
