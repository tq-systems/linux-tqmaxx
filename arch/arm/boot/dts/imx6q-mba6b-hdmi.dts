// SPDX-License-Identifier: GPL-2.0-only
/*
 * Copyright 2015-2022 TQ-Systems GmbH
 * Author: Markus Niebel <Markus.Niebel@tq-group.com>
 */

#include "imx6q-mba6b.dts"
#include "imx6qdl-mba6-hdmi.dtsi"
