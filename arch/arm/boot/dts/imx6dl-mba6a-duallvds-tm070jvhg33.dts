// SPDX-License-Identifier: GPL-2.0-only
/*
 * Copyright (c) 2019-2023 TQ-Systems GmbH <linux@ew.tq-group.com>,
 * D-82229 Seefeld, Germany.
 * Author: Markus Niebel <Markus.Niebel@tq-group.com>
 */

#include "imx6dl-mba6a.dts"
#include "imx6qdl-mba6-duallvds-tm070jvhg33.dtsi"
