// SPDX-License-Identifier: GPL-2.0-or-later OR MIT
/*
 * Device Tree file for TQ-Systems TQMa571x SoM.
 *
 * Copyright (c) 2020-2022 TQ-Systems GmbH <linux@ew.tq-group.com>, D-82229 Seefeld, Germany.
 * Author: Michael Krummsdorf, Matthias Schiffer
 */

#include "am5718.dtsi"
#include "am57xx-tqma57xx.dtsi"
#include "dra72x-mmc-iodelay.dtsi"

&mmc2 {
	pinctrl-names = "default", "hs", "ddr_1_8v", "hs200_1_8v";
	pinctrl-0 = <&mmc2_pins_default>;
	pinctrl-1 = <&mmc2_pins_hs>;
	pinctrl-2 = <&mmc2_pins_ddr_rev20 &mmc2_iodelay_ddr_conf>;
	pinctrl-3 = <&mmc2_pins_hs200 &mmc2_iodelay_hs200_rev20_conf>;
};
