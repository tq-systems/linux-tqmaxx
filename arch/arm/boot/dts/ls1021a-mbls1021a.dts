// SPDX-License-Identifier: (GPL-2.0-or-later OR X11)
/*
 * Copyright 2013-2014 Freescale Semiconductor, Inc.
 * Copyright 2018 TQ-Systems GmbH
 */

/dts-v1/;
#include "ls1021a-mbls1021a.dtsi"

&dcu {
	status = "disabled";
};
