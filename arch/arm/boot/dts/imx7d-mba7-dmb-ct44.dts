// SPDX-License-Identifier: (GPL-2.0-or-later OR MIT)
/*
 * Copyright 2016-2019 TQ-Systems GmbH
 * Author: Marco Felsch
 *         Markus Niebel <Markus.Niebel@tq-group.com>
 */

#include "imx7d-mba7.dts"
#include "imx7-mba7-lcdif.dtsi"
#include "imx7-mba7-dmb-ct44.dtsi"
