// SPDX-License-Identifier: (GPL-2.0-or-later OR MIT)
/*
 * Copyright 2014-2022 TQ-Systems GmbH
 * Author: Markus Niebel <Markus.Niebel@tq-group.com>
 */

#include "imx6qdl-mba6-pd.dtsi"

&backlight {
	pwms = <&pwm1 0 20000 0>; /* 50 kHz */
	brightness-levels = <0 1 4 8 16 32 64 128 255>;
	default-brightness-level = <8>;
	status = "okay";
};

&display0 {
	status = "okay";
};

&panel {
	compatible = "cdtech,s070swv29hg-dc44";
};

&polytouch {
	gain = <20>;
	touchscreen-size-x = <800>;
	touchscreen-size-y = <480>;
	status = "okay";
};
