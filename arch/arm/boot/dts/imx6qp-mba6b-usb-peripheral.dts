// SPDX-License-Identifier: GPL-2.0-only
/*
 * Copyright 2017-2022 TQ-Systems GmbH
 * Author: Markus Niebel <Markus.Niebel@tq-group.com>
 */

#include "imx6qp-mba6b.dts"
#include "imx6qdl-mba6-usb-peripheral.dtsi"
