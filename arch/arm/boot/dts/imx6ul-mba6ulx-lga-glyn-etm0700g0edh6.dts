// SPDX-License-Identifier: (GPL-2.0-or-later OR MIT)
/*
 * Copyright 2018 TQ-Systems GmbH
 * Author: Markus Niebel <Markus.Niebel@tq-group.com>
 */

#include "imx6ul-mba6ulx-lga.dts"
#include "imx6ul-mba6ul-lcdif.dtsi"
#include "imx6ul-mba6ul-glyn-etm0700g0edh6.dtsi"
