// SPDX-License-Identifier: (GPL-2.0-or-later OR MIT)
/*
 * Copyright 2015 TQ Systems GmbH
 * Author: Markus Niebel <Markus.Niebel@tq-group.com>
 */

#include "imx6dl-mba6b.dts"
#include "imx6qdl-mba6-hdmi.dtsi"
#include "imx6qdl-mba6-lvds-tm070jvhg33.dtsi"
