// SPDX-License-Identifier: (GPL-2.0-or-later OR MIT)
/*
 * Copyright 2019 TQ Systems GmbH
 * Author: Markus Niebel <Markus.Niebel@tq-group.com>
 */

#include "imx6q-mba6b.dts"
#include "imx6qdl-mba6-duallvds-tm070jvhg33.dtsi"
