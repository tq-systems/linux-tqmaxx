// SPDX-License-Identifier: GPL-2.0-only
/*
 * Copyright 2019-2022 TQ-Systems GmbH
 * Author: Markus Niebel <linux@ew.tq-group.com>
 */

#include "imx6q-mba6a.dts"
#include "imx6qdl-mba6-duallvds-tm070jvhg33.dtsi"
