// SPDX-License-Identifier: (GPL-2.0+ OR MIT)
/*
 * Device Tree file for TQ AM572x baseboard MBa57xx.
 *
 * Copyright 2020 TQ-Systems GmbH
 *
 * Author: Michael Krummsdorf <michael.krummsdorf@tq-group.com>
 */

#include "am572x-mba57xx.dts"
#include "am57xx-mba57xx-lvds-tm070jvhg33.dtsi"

