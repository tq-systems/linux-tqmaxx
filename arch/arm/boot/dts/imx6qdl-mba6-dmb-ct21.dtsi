// SPDX-License-Identifier: (GPL-2.0-or-later OR MIT)
/*
 * Copyright 2014 TQ-Systems GmbH
 * Author: Markus Niebel <Markus.Niebel@tq-group.com>
 */

&backlight {
	brightness-levels = <0 2 4 8 16 32 64 128 255>;
	default-brightness-level = <8>;
	status = "okay";
};

&display0 {
	status = "okay";
};

&panel {
	compatible = "dmb,s070pws19hp_fc21";
};

&polytouch {
	gain = <20>;

	touchscreen-size-x = <1024>;
	touchscreen-size-y = <600>;

	status = "okay";
};
