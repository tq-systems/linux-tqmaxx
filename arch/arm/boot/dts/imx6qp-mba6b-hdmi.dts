// SPDX-License-Identifier: (GPL-2.0-or-later OR MIT)
/*
 * Copyright 2014 TQ-Systems GmbH
 * Author: Markus Niebel <Markus.Niebel@tq-group.com>
 */

#include "imx6qp-mba6b.dts"
#include "imx6qdl-mba6-hdmi.dtsi"
