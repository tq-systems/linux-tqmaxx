/*
 * Copyright (C) 2018 TQ Systems GmbH
 *
 * This program is free software; you can redistribute it and/or modify
 * it under the terms of the GNU General Public License version 2 as
 * published by the Free Software Foundation.
 */

#include "imx7d-mba7.dts"
#include "imx7-mba7-m4.dtsi"
