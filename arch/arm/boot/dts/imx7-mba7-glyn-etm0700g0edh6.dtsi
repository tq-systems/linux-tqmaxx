// SPDX-License-Identifier: (GPL-2.0-or-later OR MIT)
/*
 * Copyright 2016-2019 TQ-Systems GmbH
 * Author: Marco Felsch
 *         Markus Niebel <Markus.Niebel@tq-group.com>
 */

&backlight {
	/* 1 kHz as stated by GLYN FAE */
	pwms = <&pwm1 0 1000000 1>;
	brightness-levels = <16 32 64 96 128 160 180 200 255>;
	default-brightness-level = <5>;
	status = "okay";
};

&lcdif {
	status = "okay";
};

&panel {
	compatible = "edt,etm0700g0edh6";
};

&polytouch {
	gain = <1>;
	offset = <0>;
	threshold = <0x0f>;

	/* no wake gpio for this variant */
	/delete-property/ wake-gpios;

	/*
	 * do not use size settings, display touch reads
	 * out and uses 1792 x 1024 (tested with ETM0700G0EDH6)
	 */

	status = "okay";
};
