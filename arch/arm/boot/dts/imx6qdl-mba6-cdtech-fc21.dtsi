// SPDX-License-Identifier: (GPL-2.0-or-later OR MIT)
/*
 * Copyright (c) 2014-2023 TQ-Systems GmbH <linux@ew.tq-group.com>,
 * D-82229 Seefeld, Germany.
 * Author: Markus Niebel <Markus.Niebel@tq-group.com>
 */

#include "imx6qdl-mba6-pd.dtsi"

&backlight {
	brightness-levels = <0 2 4 8 16 32 64 128 255>;
	default-brightness-level = <8>;
	status = "okay";
};

&display0 {
	status = "okay";
};

&panel {
	compatible = "cdtech,s070pws19hp-fc21";
};

&polytouch {
	gain = <20>;
	touchscreen-size-x = <1024>;
	touchscreen-size-y = <600>;

	status = "okay";
};
