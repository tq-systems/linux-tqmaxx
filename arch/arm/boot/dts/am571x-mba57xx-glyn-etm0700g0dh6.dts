// SPDX-License-Identifier: (GPL-2.0+ OR MIT)
/*
 * Device Tree file for TQ AM571x baseboard MBa57xx.
 *
 * Copyright 2020 TQ-Systems GmbH
 *
 * Author: Michael Krummsdorf <michael.krummsdorf@tq-group.com>
 */

#include "am571x-mba57xx.dts"
#include "am57xx-mba57xx-glyn-etm0700g0dh6.dtsi"

