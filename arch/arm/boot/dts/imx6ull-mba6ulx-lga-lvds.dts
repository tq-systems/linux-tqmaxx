/*
 * Copyright 2018 Markus Niebel, TQ Systems GmbH
 *
 * The code contained herein is licensed under the GNU General Public
 * License. You may obtain a copy of the GNU General Public License
 * Version 2 or later at the following locations:
 *
 * http://www.opensource.org/licenses/gpl-license.html
 * http://www.gnu.org/copyleft/gpl.html
 */

#include "imx6ull-mba6ulx-lga.dts"
#include "imx6ul-mba6ul-lcdif.dtsi"
#include "imx6ul-mba6ul-lvds.dtsi"
