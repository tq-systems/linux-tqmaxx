/*
 * Copyright (C) 2015-2016 Texas Instruments Incorporated - http://www.ti.com/
 *
 * Copyright (C) 2017 TQ Systems (ported AM57xx IDK to TQMa57xx)
 *
 * Author: Stefan Lange <s.lange@gateware.de>
 *
 * This program is free software; you can redistribute it and/or modify
 * it under the terms of the GNU General Public License version 2 as
 * published by the Free Software Foundation.
 */

/dts-v1/;

#include "tqma571x.dtsi"
#include "tqma57xx-mba57xx.dtsi"

/ {
	model = "TQ TQMa5718 MBa57xx";
	compatible = "tq,tqma5718-mba57xx", "tq,tqma5718", "ti,am5718",
		     "ti,dra7";
};
