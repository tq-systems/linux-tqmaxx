// SPDX-License-Identifier: (GPL-2.0-or-later OR MIT)
/*
 * Copyright 2018 TQ Systems GmbH
 * Author: Markus Niebel <Markus.Niebel@tq-group.com>
 */

&backlight {
	/* 1 kHz as stated by GLYN FAE */
	pwms = <&pwm1 0 1000000>;
	brightness-levels = <255 200 180 160 128 96 64 32 16>;
	default-brightness-level = <5>;

	status = "okay";
};

&display0 {
	status = "okay";
};

&panel {
	compatible = "edt,etm0700g0edh6";
};

&polytouch {
	gain = <1>;
	offset = <0>;
	threshold = <0x0f>;

	/* no wake gpio for this variant */
	/delete-property/ wake-gpios;

	status = "okay";
};
