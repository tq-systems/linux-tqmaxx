// SPDX-License-Identifier: (GPL-2.0-or-later OR MIT)
/*
 * Copyright (c) 2015-2023 TQ-Systems GmbH <linux@ew.tq-group.com>,
 * D-82229 Seefeld, Germany.
 * Author: Markus Niebel <Markus.Niebel@tq-group.com>
 */

#include "imx7s-mba7.dts"
#include "imx7-mba7-lcdif.dtsi"
#include "imx7-mba7-lvds.dtsi"
