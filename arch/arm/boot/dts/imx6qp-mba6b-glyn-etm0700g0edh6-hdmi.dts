// SPDX-License-Identifier: (GPL-2.0-or-later OR MIT)
/*
 * Copyright 2017-2018 TQ-Systems GmbH
 * Author: Markus Niebel <Markus.Niebel@tq-group.com>
 *         Max Merchel
 */

#include "imx6qp-mba6b.dts"
#include "imx6qdl-mba6-pd.dtsi"
#include "imx6qdl-mba6-glyn-etm0700g0edh6.dtsi"
#include "imx6qdl-mba6-hdmi.dtsi"
