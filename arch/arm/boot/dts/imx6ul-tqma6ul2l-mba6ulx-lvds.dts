// SPDX-License-Identifier: (GPL-2.0-or-later OR MIT)
/*
 * Copyright 2018-2022 TQ-Systems GmbH
 * Author: Markus Niebel <Markus.Niebel@tq-group.com>
 */

#include "imx6ul-tqma6ul2l-mba6ulx.dts"
#include "mba6ulx-lcdif.dtsi"
#include "mba6ulx-lvds.dtsi"
