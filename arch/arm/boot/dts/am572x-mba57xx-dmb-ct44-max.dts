/*
 * Copyright (C) 2017 TQ Systems
 *
 * Author: Stefan Lange <s.lange@gateware.de>
 *
 * This program is free software; you can redistribute it and/or modify
 * it under the terms of the GNU General Public License version 2 as
 * published by the Free Software Foundation.
 */

#include "am572x-mba57xx.dts"
#include "am57xx-mba57xx-dmb-ct44-max.dtsi"

