// SPDX-License-Identifier: (GPL-2.0-or-later OR MIT)
/*
 * Copyright (c) 2014-2023 TQ-Systems GmbH <linux@ew.tq-group.com>,
 * D-82229 Seefeld, Germany.
 * Author: Markus Niebel <Markus.Niebel@tq-group.com>
 */

#include "imx6dl-mba6b.dts"
#include "imx6qdl-mba6-cdtech-dc44.dtsi"
