// SPDX-License-Identifier: GPL-2.0-or-later
/*
 * Copyright 2013 Sascha Hauer, Pengutronix
 */

#include "imx6q.dtsi"
#include "imx6qp.dtsi"
#include "imx6qdl-tqma6b.dtsi"
#include "imx6qdl-tqma6.dtsi"

/ {
	memory: memory {
		reg = <0x10000000 0x40000000>;
	};
};

&prg1 {
	memory-region = <&memory>;
};

&prg2 {
	memory-region = <&memory>;
};
