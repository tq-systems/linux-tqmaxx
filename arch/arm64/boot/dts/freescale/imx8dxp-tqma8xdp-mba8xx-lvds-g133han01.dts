// SPDX-License-Identifier: (GPL-2.0-or-later OR MIT)
/*
 * Copyright (c) 2021-2023 TQ-Systems GmbH <linux@ew.tq-group.com>,
 * D-82229 Seefeld, Germany.
 * Author: Alexander Stein
 */

#include "imx8dxp-tqma8xdp-mba8xx.dts"
#include "tqma8xx-display.dtsi"
#include "mba8xx-lvds-g133han01.dtsi"
