/*
 * Copyright 2019 TQ Systems GmbH
 * Markus Niebel
 *
 * This program is free software; you can redistribute it and/or
 * modify it under the terms of the GNU General Public License
 * as published by the Free Software Foundation; either version 2
 * of the License, or (at your option) any later version.
 *
 * This program is distributed in the hope that it will be useful,
 * but WITHOUT ANY WARRANTY; without even the implied warranty of
 * MERCHANTABILITY or FITNESS FOR A PARTICULAR PURPOSE.  See the
 * GNU General Public License for more details.
 */

/dts-v1/;

#include "fsl-imx8qxp-tqma8xqp.dtsi"
#include "mbpa8xx-common.dtsi"

/ {
	model = "TQ Systems i.MX8QXP TQMa8XQP on MBpa8Xx";
	compatible = "tq,tqma8xqp-mbpa8xx", "tq,tqma8xqp", "fsl,imx8qxp";
};
