// SPDX-License-Identifier: (GPL-2.0-or-later OR MIT)
/*
 * Copyright 2018-2022 TQ-Systems GmbH
 * Author: Alexander Stein <linux@ew.tq-group.com>
 */

/dts-v1/;

#include "imx8qxp-tqma8xqps.dtsi"
#include "mb-smarc-2-common.dtsi"

/ {
	model = "TQ-Systems i.MX8QXP TQMa8XQPS on MB-SMARC-2";
	compatible = "tq,imx8qxp-tqma8xqps-mb-smarc-2", "tq,imx8qxp-tqma8xqps", "fsl,imx8qxp";
};
