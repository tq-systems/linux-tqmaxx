// SPDX-License-Identifier: (GPL-2.0-or-later OR MIT)
/*
 * Copyright (c) 2021-2023 TQ-Systems GmbH <linux@ew.tq-group.com>,
 * D-82229 Seefeld, Germany.
 * Author: Alexander Stein
 */

#include "imx8qxp-tqma8xqps-mb-smarc-2.dts"
#include "tqma8xxs-display.dtsi"
#include "mb-smarc-2-lvds-g133han01.dtsi"
