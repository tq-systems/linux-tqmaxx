// SPDX-License-Identifier: (GPL-2.0-or-later OR MIT)
/*
 * Copyright 2019-2020 TQ-Systems GmbH
 */

/delete-node/ &spidev0_0;

/ {
	aliases {
		rtc2 = &mcp795;
	};
};

&lpspi0 {
	mcp795: rtc@0 {
		reg = <0>;
		spi-max-frequency = <5000000>;
		compatible = "maxim,mcp795";
		status = "okay";
	};
};
