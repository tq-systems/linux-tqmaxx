// SPDX-License-Identifier: GPL-2.0-or-later OR MIT
/*
 * Copyright 2021 TQ-Systems GmbH
 */

/dts-v1/;

#include "imx8mp-tqma8mpxl.dtsi"
#include "imx8mp-mba8mpxl.dtsi"
#include "imx8mp-mba8mpxl-rpmsg.dtsi"
