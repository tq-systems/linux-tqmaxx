// SPDX-License-Identifier: (GPL-2.0-or-later OR MIT)
/*
 * Copyright 2021 TQ-Systems GmbH
 */

#include "imx8qxp-tqma8xqp-mba8xx.dts"
#include "mba8xx-lvds0-tm070jvhg33.dtsi"
#include "tqma8xx-display.dtsi"
