// SPDX-License-Identifier: GPL-2.0-or-later OR MIT
/*
 * Copyright 2022 TQ-Systems GmbH
 * Author: Markus Niebel <linux@ew.tq-group.com>
 */

#include "imx8mp-tqma8mpql-mba8mpxl-hdmi.dts"
#include "imx8mp-tqma8mpql-npu.dtsi"
