// SPDX-License-Identifier: (GPL-2.0-or-later OR MIT)
/*
 * Copyright 2021-2022 TQ-Systems GmbH
 * Author: Alexander Stein <linux@ew.tq-group.com>
 */

#include "imx8dxp.dtsi"
#include "tqma8xxs-common.dtsi"

/ {
	model = "TQ-Systems i.MX8DXP TQMa8XDPS";
	compatible = "tq,imx8dxp-tqma8xdps", "fsl,imx8dxp", "fsl,imx8qxp";
};

&pmic_thermal0 {
	cooling-maps {
		map0 {
			cooling-device =
				<&A35_0 THERMAL_NO_LIMIT THERMAL_NO_LIMIT>,
				<&A35_1 THERMAL_NO_LIMIT THERMAL_NO_LIMIT>;
		};
	};
};
