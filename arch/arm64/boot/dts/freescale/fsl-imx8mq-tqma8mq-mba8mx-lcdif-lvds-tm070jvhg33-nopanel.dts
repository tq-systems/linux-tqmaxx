/*
 * Copyright 2019 TQ Systems GmbH
 *
 * This program is free software; you can redistribute it and/or
 * modify it under the terms of the GNU General Public License
 * as published by the Free Software Foundation; either version 2
 * of the License, or (at your option) any later version.
 *
 * This program is distributed in the hope that it will be useful,
 * but WITHOUT ANY WARRANTY; without even the implied warranty of
 * MERCHANTABILITY or FITNESS FOR A PARTICULAR PURPOSE.  See the
 * GNU General Public License for more details.
 */

#include "fsl-imx8mq-tqma8mq-mba8mx-lcdif-lvds-tm070jvhg33.dts"

/ {
	/delete-node/ panel-lvds0;
};

&dsi_lvds_bridge {
	ti,lvds-format = <1>;
	ti,lvds-bpp = <24>;
	ti,width-mm = <150>;
	ti,height-mm = <94>;
	/* TODO: needed for enable since lacking regulator support */
	enable-gpios = <&expander2 2 GPIO_ACTIVE_HIGH>;
	status = "okay";

	display-timings {
		lvds {
			clock-frequency = <68000000>;
			hactive = <1280>;
			vactive = <800>;
			hfront-porch = <64>;
			hback-porch = <5>;
			hsync-len = <1>;
			vfront-porch = <40>;
			vback-porch = <2>;
			vsync-len = <1>;
			hsync-active = <0>;
			vsync-active = <0>;
			de-active = <1>;
			pixelclk-active = <0>;
		};
	};

	ports {
		/delete-node/ port@1;
	};
};
