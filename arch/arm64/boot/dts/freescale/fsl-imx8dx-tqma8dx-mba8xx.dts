/*
 * Copyright 2019 TQ Systems GmbH
 *
 * This program is free software; you can redistribute it and/or
 * modify it under the terms of the GNU General Public License
 * as published by the Free Software Foundation; either version 2
 * of the License, or (at your option) any later version.
 *
 * This program is distributed in the hope that it will be useful,
 * but WITHOUT ANY WARRANTY; without even the implied warranty of
 * MERCHANTABILITY or FITNESS FOR A PARTICULAR PURPOSE.  See the
 * GNU General Public License for more details.
 */

/dts-v1/;

#include "fsl-imx8dx-tqma8dx.dtsi"
#include "mba8xx-common.dtsi"

/ {
	model = "TQ Systems i.MX8DX TQMa8DX on MBa8xX";
	compatible = "tq,tqma8dx-mba8xx", "tq,tqma8dx", "fsl,imx8dx";
};
