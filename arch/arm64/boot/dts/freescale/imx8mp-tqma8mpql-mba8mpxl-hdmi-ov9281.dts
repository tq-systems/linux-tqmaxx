// SPDX-License-Identifier: (GPL-2.0-or-later OR MIT)
/*
 * Copyright 2021-2023 TQ-Systems GmbH <linux@ew.tq-group.com>,
 * D-82229 Seefeld, Germany.
 * Author: Alexander Stein
 */

/*
 * Note: This is just a transitional device tree file and will be removed.
 * Use the device tree included below instead.
 */
#include "imx8mp-tqma8mpql-mba8mpxl-ov9281.dts"
