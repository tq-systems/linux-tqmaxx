/*
 * Copyright 2018-2020 TQ Systems GmbH
 *
 * This program is free software; you can redistribute it and/or
 * modify it under the terms of the GNU General Public License
 * as published by the Free Software Foundation; either version 2
 * of the License, or (at your option) any later version.
 *
 * This program is distributed in the hope that it will be useful,
 * but WITHOUT ANY WARRANTY; without even the implied warranty of
 * MERCHANTABILITY or FITNESS FOR A PARTICULAR PURPOSE.  See the
 * GNU General Public License for more details.
 */

/delete-node/ &spidev0_0;

&lpspi0 {
	mcp795: rtc@0 {
		reg = <0>;
		spi-max-frequency = <5000000>;
		compatible = "maxim,mcp795";
		status = "okay";
	};
};