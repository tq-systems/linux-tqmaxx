// SPDX-License-Identifier: (GPL-2.0-or-later OR MIT)
/*
 * Copyright (c) 2018-2023 TQ-Systems GmbH <linux@ew.tq-group.com>,
 * D-82229 Seefeld, Germany.
 * Author: Alexander Stein
 */

#include "imx8dxp.dtsi"
#include "tqma8xx-common.dtsi"

/ {
	model = "TQ-Systems i.MX8DXP TQMa8XDP";
	compatible = "tq,imx8dxp-tqma8xdp", "fsl,imx8dxp", "fsl,imx8qxp";
};

&pmic_thermal0 {
	cooling-maps {
		map0 {
			cooling-device =
				<&A35_0 THERMAL_NO_LIMIT THERMAL_NO_LIMIT>,
				<&A35_1 THERMAL_NO_LIMIT THERMAL_NO_LIMIT>;
		};
	};
};
