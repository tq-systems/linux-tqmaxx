// SPDX-License-Identifier: (GPL-2.0-or-later OR MIT)
/*
 * Copyright 2020 - 2021 TQ-Systems GmbH
 */

/dts-v1/;

#include "imx8qxp-mb-smarc-2-r0200.dts"
#include "mb-smarc-2-display.dtsi"
#include "mb-smarc-2-lvds0-tm070jvhg33.dtsi"
