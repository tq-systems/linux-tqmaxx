// SPDX-License-Identifier: (GPL-2.0-or-later OR MIT)
/*
 * Copyright 2018-2020 TQ-Systems GmbH
 */

/dts-v1/;

#include <dt-bindings/net/ti-dp83867.h>

#include "imx8qxp.dtsi"
#include "tqma8xxs-common.dtsi"
#include "imx8qxp-tqma8xqps.dtsi"
#include "mb-smarc-2-common.dtsi"

/ {
	model = "TQ-Systems i.MX8QXP TQMa8XQPS REV.0200 on MB-SMARC-2";
};

&reg_sdvmmc {
	gpio = <&lsio_gpio4 19 GPIO_ACTIVE_LOW>;
	/delete-property/ enable-active-high;
};

&usdhc2 {
	no-1-8-v;
};
