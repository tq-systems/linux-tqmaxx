/*
 * Copyright 2018 -2019 TQ Systems GmbH
 *
 * This program is free software; you can redistribute it and/or
 * modify it under the terms of the GNU General Public License
 * as published by the Free Software Foundation; either version 2
 * of the License, or (at your option) any later version.
 *
 * This program is distributed in the hope that it will be useful,
 * but WITHOUT ANY WARRANTY; without even the implied warranty of
 * MERCHANTABILITY or FITNESS FOR A PARTICULAR PURPOSE.  See the
 * GNU General Public License for more details.
 */

/dts-v1/;

#include <dt-bindings/net/ti-dp83867.h>
#include "fsl-imx8qxp-tqma8xqps.dtsi"
#include "mb-smarc-2-common.dtsi"

/ {
	model = "TQ Systems i.MX8QXP TQMa8XQPS on MB-SMARC-2";
	compatible = "tq,tqma8xqps-mb-smarc-2", "tq,tqma8xqps", "fsl,imx8qxp";
};
