// SPDX-License-Identifier: (GPL-2.0-or-later OR MIT)
/*
 * Copyright 2021-2023 TQ-Systems GmbH <linux@ew.tq-group.com>,
 * D-82229 Seefeld, Germany.
 * Author: Alexander Stein
 */

#include "imx8mn-tqma8mqnl-mba8mx-lcdif-lvds-tm070jvhg33.dts"
#include "imx8mn-mba8mx-imx327.dtsi"
