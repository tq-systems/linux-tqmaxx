/*
 * Copyright 2018-2019 TQ Systems GmbH
 *
 * This program is free software; you can redistribute it and/or
 * modify it under the terms of the GNU General Public License
 * as published by the Free Software Foundation; either version 2
 * of the License, or (at your option) any later version.
 *
 * This program is distributed in the hope that it will be useful,
 * but WITHOUT ANY WARRANTY; without even the implied warranty of
 * MERCHANTABILITY or FITNESS FOR A PARTICULAR PURPOSE.  See the
 * GNU General Public License for more details.
 */

/* First 128KB is for PSCI ATF. */
/* Last 127M is for M4/RPMSG */
/memreserve/ 0x80000000 0x08000000;

#include "fsl-imx8qxp.dtsi"
#include "tqma8xx-common.dtsi"

/ {
	model = "TQ Systems i.MX8QXP TQMa8XQP";
	compatible = "tq,tqma8xqp", "fsl,imx8qxp";
};
