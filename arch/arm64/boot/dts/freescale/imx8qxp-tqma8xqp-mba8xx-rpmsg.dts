// SPDX-License-Identifier: (GPL-2.0-or-later OR MIT)
/*
 * Copyright 2021-2022 TQ-Systems GmbH
 * Author: Alexander Stein <linux@ew.tq-group.com>
 */

#include "imx8qxp-tqma8xqp-mba8xx.dts"
#include "tqma8xx-rpmsg.dtsi"
