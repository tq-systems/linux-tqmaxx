/*
 * Copyright 2019 TQ Systems GmbH
 *
 * This program is free software; you can redistribute it and/or
 * modify it under the terms of the GNU General Public License
 * as published by the Free Software Foundation; either version 2
 * of the License, or (at your option) any later version.
 *
 * This program is distributed in the hope that it will be useful,
 * but WITHOUT ANY WARRANTY; without even the implied warranty of
 * MERCHANTABILITY or FITNESS FOR A PARTICULAR PURPOSE.  See the
 * GNU General Public License for more details.
 */

#include "fsl-imx8dxp.dtsi"
#include "tqma8xx-common.dtsi"

/ {
	model = "TQ Systems i.MX8DXP TQMa8XDP";
	compatible = "tq,tqma8xdp", "fsl,imx8dxp", "fsl,imx8qxp";
};
