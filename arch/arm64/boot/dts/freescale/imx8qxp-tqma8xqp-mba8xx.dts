// SPDX-License-Identifier: (GPL-2.0-or-later OR MIT)
/*
 * Copyright 2018-2022 TQ-Systems GmbH
 * Author: Alexander Stein <linux@ew.tq-group.com>
 */

/dts-v1/;

#include "imx8qxp-tqma8xqp.dtsi"
#include "mba8xx-common.dtsi"

/ {
	model = "TQ-Systems i.MX8QXP TQMa8XQP on MBa8Xx";
	compatible = "tq,imx8qxp-tqma8xqp-mba8xx", "tq,imx8qxp-tqma8xqp", "fsl,imx8qxp";
};
