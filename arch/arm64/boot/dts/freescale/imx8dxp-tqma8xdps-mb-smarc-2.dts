// SPDX-License-Identifier: (GPL-2.0-or-later OR MIT)
/*
 * Copyright 2021 TQ-Systems GmbH
 */

/dts-v1/;

#include "imx8dxp-tqma8xdps.dtsi"
#include "mb-smarc-2-common.dtsi"

/ {
	model = "TQ-Systems i.MX8DXP TQMa8XDPS on MB-SMARC-2";
	compatible = "tq,imx8dxp-tqma8xdps-mb-smarc-2", "tq,imx8dxp-tqma8xdps",
		     "fsl,imx8dxp", "fsl,imx8qxp";
};
