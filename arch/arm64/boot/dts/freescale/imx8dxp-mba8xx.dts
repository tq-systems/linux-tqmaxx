// SPDX-License-Identifier: (GPL-2.0-or-later OR MIT)
/*
 * Copyright 2018-2021 TQ-Systems GmbH
 */

/dts-v1/;

#include "imx8dxp-tqma8xdp.dtsi"
#include "mba8xx-common.dtsi"

/ {
	model = "TQ-Systems i.MX8QXP TQMa8XQP on MBa8Xx";
	compatible = "tq,imx8dxp-mba8xx", "tq,imx8dxp-tqma8xdp", "fsl,imx8dxp",
		     "fsl,imx8qxp";
};
