// SPDX-License-Identifier: GPL-2.0
/*
 * Device Tree Source for the HiHope RZ/G2N Rev.2.0 connected to sub board
 *
 * Copyright (C) 2019 Renesas Electronics Corp.
 */

#include <dt-bindings/gpio/gpio.h>

#include "r8a774b1-hihope-rzg2n-rev2.dts"
#include "hihope-rzg2-ex.dtsi"

/ {
	model = "HopeRun HiHope RZ/G2N (Rev.2.0) with sub board";
	compatible = "hoperun,hihope-rzg2-ex", "hoperun,hihope-rzg2n",
		     "renesas,r8a774b1";
};

&gpio7 {
	pcie-en-gpio {
		gpio-hog;
		gpios = <3 GPIO_ACTIVE_HIGH>;
		output-high;
		line-name = "pcie-en-gpio";
	};
};

&pciec1 {
	status = "okay";
};
