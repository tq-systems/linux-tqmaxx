// SPDX-License-Identifier: GPL-2.0
/*
 * Device Tree Source for the HiHope RZ/G2M Rev.2.0 connected to sub board
 *
 * Copyright (C) 2019 Renesas Electronics Corp.
 */

#include <dt-bindings/gpio/gpio.h>

#include "r8a774a1-hihope-rzg2m-rev2.dts"
#include "hihope-rzg2-ex.dtsi"

/ {
	model = "HopeRun HiHope RZ/G2M (Rev.2.0) with sub board";
	compatible = "hoperun,hihope-rzg2-ex", "hoperun,hihope-rzg2m",
		     "renesas,r8a774a1";
};

/* SW43 should be OFF, if in ON state SATA port will be activated */
&pciec1 {
	status = "okay";
};

&gpio7 {
	pcie-en-gpio {
		gpio-hog;
		gpios = <3 GPIO_ACTIVE_HIGH>;
		output-high;
		line-name = "pcie-en-gpio";
	};
};
