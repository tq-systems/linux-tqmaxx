// SPDX-License-Identifier: GPL-2.0
/*
 * Device Tree Source for the TQMaRZG2H-C on a MBaRZG2X
 * with a TM070VJHG33 LVDS panel
 *
 * Copyright (C) 2021 TQ-Systems GmbH
 */

#include <dt-bindings/gpio/gpio.h>

#include "tqmarzg2h_c.dtsi"
#include "mbarzg2x-common.dtsi"
#include "mbarzg2x-lvds-tm070jvhg33.dtsi"
