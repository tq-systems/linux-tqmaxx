// SPDX-License-Identifier: GPL-2.0-or-later OR MIT
/*
 * Copyright (c) 2021-2023 TQ-Systems GmbH <linux@ew.tq-group.com>, D-82229 Seefeld, Germany.
 * Author: Andreas Dumberger, Paul Gerber
 *
 */

#include "r8a774e1-tqmarzg2h-mbarzg2x.dts"
#include "mbarzg2x-lvds-tm070jvhg33.dtsi"
