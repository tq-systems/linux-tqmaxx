## Documentation/devicetree/bindings/thermal/am64-thermal.yaml
```yaml
# SPDX-License-Identifier: (GPL-2.0-only OR BSD-2-Clause)
%YAML 1.2
---
$id: http://devicetree.org/schemas/thermal/am64-thermal.yaml#
$schema: http://devicetree.org/meta-schemas/core.yaml#

title: Texas Instruments AM64x VTM binding

maintainers:
  - Matthias Schiffer <matthias.schiffer@ew.tq-group.com>

properties:
  compatible:
    const: ti,am64-vtm

  reg:
    minItems: 2
    maxItems: 2

  reg-names:
    minItems: 2
    maxItems: 2
    items:
      - const: cfg1
      - const: cfg2

  power-domains:
    maxItems: 1

  "#thermal-sensor-cells":
    const: 1

required:
  - compatible
  - reg
  - reg-names
  - power-domains
  - "#thermal-sensor-cells"

additionalProperties: false

examples:
  - |
    #include <dt-bindings/soc/ti,sci_pm_domain.h>
    vtm0: temperature-sensor@b00000 {
        compatible = "ti,am64-vtm";
        reg = <0x00 0x00b00000 0x00 0x400>,
              <0x00 0x00b01000 0x00 0x400>;
        reg-names = "cfg1", "cfg2";
        power-domains = <&k3_pds 95 TI_SCI_PD_EXCLUSIVE>;
        #thermal-sensor-cells = <1>;
    };

    thermal_zones: thermal-zones {
        mpu0_thermal: mpu0-thermal {
            polling-delay-passive = <250>; /* milliseconds */
            polling-delay = <500>; /* milliseconds */
            thermal-sensors = <&vtm0 0>;

            trips {
                mpu0_crit: mpu0-crit {
                    temperature = <105000>; /* milliCelsius */
                    hysteresis = <2000>; /* milliCelsius */
                    type = "critical";
                };
            };
        };

        mpu1_thermal: mpu1-thermal {
            polling-delay-passive = <250>; /* milliseconds */
            polling-delay = <500>; /* milliseconds */
            thermal-sensors = <&vtm0 1>;

            trips {
                mpu1_crit: mpu1-crit {
                    temperature = <105000>; /* milliCelsius */
                    hysteresis = <2000>; /* milliCelsius */
                    type = "critical";
                };
            };
        };
    };
...
```

## Documentation/devicetree/bindings/usb/tusb80xx.txt
```
TI USB 3.0 Hub Controller

The device node for the configuration of a TI TUSB80xx USB 3.0
Controller.

Required properties :
 - compatible : Should be "ti,tusb80xx" or one of the specific types:
	"ti,tusb8020b", "ti,tusb8041", "ti,tusb8042", "ti,tusb8043"
 - reset-gpios : Should specify the gpio for hub reset
 - reg : I2C address on the selected bus (default is <0x44>)

Examples:
	tusb80xx@84 {
		compatible = "ti,tusb80xx";
		reg = <0x44>;
		reset-gpios = <&gpio1 4 GPIO_ACTIVE_LOW>;
	};
```

## Documentation/devicetree/bindings/watchdog/fsl-imx-wdt.txt
```
* Freescale i.MX Watchdog Timer (WDT) Controller

Required properties:
- compatible : Should be "fsl,<soc>-wdt"
- reg : Should contain WDT registers location and length
- interrupts : Should contain WDT interrupt

Optional properties:
- fsl,use-wre: set if watchdog reset out (WDOG_B) signal shall be asserted

Examples:

wdt@73f98000 {
	compatible = "fsl,imx51-wdt", "fsl,imx21-wdt";
	reg = <0x73f98000 0x4000>;
	interrupts = <58>;
};
```

## drivers/gpu/drm/bridge/sn65dsi83/Kconfig
```kconfig
config DRM_TI_SN65DSI83
	bool "TI SN65DSI83 MIPI DSI to LVDS bridge"
	depends on OF
	select DRM_KMS_HELPER
	select DRM_PANEL
	select DRM_MIPI_DSI
	help
	  TI SN65DSI83 MIPI DSI to LVDS bridge driver
```

## drivers/gpu/drm/imx/dpu/Kconfig
```kconfig
config DRM_IMX_DPU
	bool "Freescale i.MX DPU DRM support"
	depends on DRM_IMX
	depends on IMX_DPU_CORE
	default y if DRM_IMX=y
```

## drivers/media/i2c/vc/Kconfig
```kconfig
# SPDX-License-Identifier: GPL-2.0

config VIDEO_HAVE_VC_SENSORS
	bool

config VIDEO_VC_SENSORS_FPGA
	tristate "Vision Components FPGA"
	depends on REGULATOR
	depends on RESET_CONTROLLER
	depends on GPIOLIB
	select VIDEO_HAVE_VC_SENSORS

config VIDEO_VC_SENSORS
	tristate "Vision Components sensors"
	depends on I2C
	depends on VIDEO_VC_SENSORS_FPGA
	select VIDEO_HAVE_VC_SENSORS
```

## drivers/mxc/Kconfig
```kconfig
# drivers/mxc/Kconfig

menu "MXC support drivers"

if SOC_IMX6Q

source "drivers/mxc/gpu-viv/Kconfig"

endif

endmenu
```
