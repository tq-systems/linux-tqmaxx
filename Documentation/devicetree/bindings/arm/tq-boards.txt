## Documentation/devicetree/bindings/arm/tq-boards.txt
```
TQ System device tree bindings
----------------------------------------

------------
TQMa6 module
------------

TQMa6-MBa6dl variant a
	compatible = "tq,mba6a", "tq,tqma6dl", "fsl,imx6dl";

TQMa6-MBa6dl variant b
	compatible = "tq,mba6a", "tq,tqma6dl", "fsl,imx6dl";

TQMa6-MBa6q variant a
	compatible = "tq,mba6a", "tq,tqma6q", "fsl,imx6q";

TQMa6-MBa6q variant b
	compatible = "tq,mba6b", "tq,tqma6q", "fsl,imx6q";

TQMa6-MBa6qp
	compatible = "tq,mba6b", "tq,tqma6qp", "fsl,imx6qp";
```

## Documentation/devicetree/bindings/display/bridge/sil,sii9022a.txt
```
Device-Tree bindings for the SiI902x hdmi transmitter.
-----------------------------------------

The SiI9022A is an ultra low-power HDMI transmitter. It supports resolutions from
standard definition 480i/p and 576i/p all the way to high-definition 720p, 1080i,
and 1080p, the highest resolution supported by HDTVs today. It also supports all
PC resolutions up to UXGA for netbooks

Required properties:
- compatible: 	Should be "sil,sii9022a".
- reg: 		The I2C address of the device.
- interrupts:	Interrupt number to the cpu.

Required nodes:

The sii9022 has one video ports. Its connection is modelled using the OF
graph bindings specified in Documentation/devicetree/bindings/graph.txt.

- Video port 0 for the HDMI output

Example:
-------

/ {
	hdmi-out {
		compatible = "hdmi-connector";
		type = "a";

		port {
			hdmi_con: endpoint {
				remote-endpoint = <&sii9022a_out>;
			};
		};
	};
};

&i2c1 {
    sii9022: hdmi@39 {
            compatible = "sil,sii9022a";
            reg = <0x39>;
            interrupts = <GIC_SPI 167 IRQ_TYPE_EDGE_RISING>;

            ports {
                    #address-cells = <1>;
                    #size-cells = <0>;

                    port@0 {
                            reg = <0>;
                            sii9022_out: endpoint {
                                    remote-endpoint = <&hdmi_con>;
                            };
                    };
            };
    };
};
```

## Documentation/devicetree/bindings/display/bridge/ti,sn65dsi83.txt
```
SN65DSI83 DSI to LVDS bridge chip
---------------------------------

This is the binding for Texas Instruments SN65DSI83 bridge.
http://www.ti.com/general/docs/lit/getliterature.tsp?genericPartNumber=sn65dsi83&fileType=pdf

Required properties:
- compatible: Must be "ti,sn65dsi83"
- reg: i2c address of the chip, 0x2d as per datasheet

Optional properties:
- vcc1v8-supply: A 1.8V supply that powers up the chip.
- enable-gpios: gpio specification for bridge_en pin (active high)

Required nodes:
This device has two video ports. Their connections are modelled using the
OF graph bindings specified in Documentation/devicetree/bindings/graph.txt.

- Video port 0 for DSI input
- Video port 1 for LVDS output

Example
-------

lvds-bridge@2d {
	compatible = "ti,sn65dsi83";
	reg = <0x2d>;

	enable-gpios = <&gpio3 31 GPIO_ACTIVE_HIGH>;

	vcc1v8-supply = <&pm8916_l6>;

	clock-names = "refclk";
	clocks = <&input_refclk>;

	ports {
		#address-cells = <1>;
		#size-cells = <0>;

		port@0 {
			reg = <0>;

			edp_bridge_in: endpoint {
				remote-endpoint = <&dsi_out>;
			};
		};

		port@1 {
			reg = <1>;

			edp_bridge_out: endpoint {
				data-lanes = <2 1 3 0>;
				lane-polarities = <0 1 0 1>;
				remote-endpoint = <&edp_panel_in>;
			};
		};
	};
}
```

## Documentation/devicetree/bindings/display/panel/edt,et1010g0dsa.txt
```
Emerging Display Technology Corp. ET1010G0DSA 10.1" WXGA TFT LVDS display panel

Required properties:
- compatible: should be "edt,et1010g0dsa"

This binding is compatible with the simple-panel binding, which is specified
in simple-panel.txt in this directory.
```

## Documentation/devicetree/bindings/display/panel/edt,etml1010g0dka.txt
```
Emerging Display Technology Corp. ETML1010G0DKA 10.1" WXGA TFT LVDS display panel

Required properties:
- compatible: should be "edt,etml1010g0dka"

This panel is the same as ET101G0DSA with an integrated capacitive multitouch panel.

This binding is compatible with the simple-panel binding, which is specified
in simple-panel.txt in this directory.
```

## Documentation/devicetree/bindings/display/panel/innolux,g150xne-l01.txt
```
Innolux G150XNE-L01 (1024 x 768) TFT LCD panel

Required properties:
- compatible: should be "innolux,g150xne-l01"
- power-supply: as specified in the base binding

This binding is compatible with the simple-panel binding, which is specified
in simple-panel.txt in this directory.
```

## Documentation/devicetree/bindings/display/panel/tianma,tm070jvhg33.txt
```
Tianma Micro-electronics TM070JVHG33 7.0" WXGA TFT LCD panel

Required properties:
- compatible: should be "tianma,tm070jvhg33" or "tianma,tm070jvhg33_mx8m"

second compatible is for usage with i.MX8M/i.MX8MN/i.MX8MN with DSI to LVDS
display bridge

This binding is compatible with the simple-panel binding, which is specified
in simple-panel.txt in this directory.
```

## Documentation/devicetree/bindings/interrupt-controller/fsl,ls-extirq.txt
```
* Freescale Layerscape external IRQs

Some Layerscape SOCs (LS1021A, LS1043A, LS1046A) support inverting
the polarity of certain external interrupt lines.

The device node must be a child of the node representing the
Supplemental Configuration Unit (SCFG).

Required properties:
- compatible: should be "fsl,<soc-name>-extirq", e.g. "fsl,ls1021a-extirq".
- interrupt-controller: Identifies the node as an interrupt controller
- #interrupt-cells: Must be 2. The first element is the index of the
  external interrupt line. The second element is the trigger type.
- interrupt-parent: phandle of GIC.
- reg: Specifies the Interrupt Polarity Control Register (INTPCR) in the SCFG.
- fsl,extirq-map: Specifies the mapping to interrupt numbers in the parent
  interrupt controller. Interrupts are mapped one-to-one to parent
  interrupts.

Optional properties:
- fsl,bit-reverse: This boolean property should be set on the LS1021A
  if the SCFGREVCR register has been set to all-ones (which is usually
  the case), meaning that all reads and writes of SCFG registers are
  implicitly bit-reversed. Other compatible platforms do not have such
  a register.

Example:
	scfg: scfg@1570000 {
		compatible = "fsl,ls1021a-scfg", "syscon";
		...
		extirq: interrupt-controller {
			compatible = "fsl,ls1021a-extirq";
			#interrupt-cells = <2>;
			interrupt-controller;
			interrupt-parent = <&gic>;
			reg = <0x1ac>;
			fsl,extirq-map = <163 164 165 167 168 169>;
			fsl,bit-reverse;
		};
	};


	interrupts-extended = <&gic GIC_SPI 88 IRQ_TYPE_LEVEL_HIGH>,
			      <&extirq 1 IRQ_TYPE_LEVEL_LOW>;
```

## Documentation/devicetree/bindings/leds/leds-pca9532.txt
```
NXP PCA9532 LED (incl. GPIO) controller

Required properties:
- compatible: must be "nxp,pca9532"
- reg: I2C address
- gpio-controller: Marks the device node as a GPIO controller.
- #gpio-cells: Should be 2:
   1) pin number
   2) optional parameters:
      - bit 0 specifies polarity (0 for normal, 1 for inverted)
- nxp,typecodes: groups of 2 bits for each of the 16 pins:
  0: None
  1: LED
  2: Beep
  3: GPIO
- nxp,statecodes: groups of 2 bits for each of the 16 pins:
  0: off
  1: on
  2: pwm0
  3: pwm1

Optional properties:
- nxp,psc: array of 2 numbers: PSC values for the two PWM channels (see datasheet)
- nxp,pwm: array of 2 numbers: PWM values for the two PWM channels (see datasheet)

Example:

	pca9532: pca9532@60 {
		compatible = "nxp,pca9532";
		gpio-controller;
		#gpio-cells = <2>;
		nxp,typecodes = <0xffffffff>;
		nxp,statecodes = <0x00000000>;
		reg = <0x60>;
	};

	sd@20098000 {
		wp-gpios = <&pca9532 5 0>;
		cd-gpios = <&pca9532 4 0>;
		cd-inverted;
		bus-width = <4>;
		status = "okay";
	};
```

## Documentation/devicetree/bindings/media/i2c/imx290.txt
```
* Sony IMX290 / IMX327 Digital Image Sensor

Required Properties:
- compatible: value should be
  -  "sony,imx290" for imx290 sensor
  -  "sony,imx327" for imx327 sensor
- reg: I2C bus address of the device
- clocks: reference to the xclk input clock.
- clock-names: Must include the following entry: "xclk"
- clock-frequency: must be 37125000
- vdda-supply: Analog voltage supply
- vdddo-supply: Digital I/O voltage supply
- vddd-supply: Digital core voltage supply


Optional Properties:
- reset-gpios: Sensor reset GPIO

The imx274 device node should contain one 'port' child node with
an 'endpoint' subnode. For further reading on port node refer to
Documentation/devicetree/bindings/media/video-interfaces.txt.

Example:
	sensor@1a {
		compatible = "sony,imx274";
		reg = <0x1a>;
		reset-gpios = <&gpio_sensor 0 0>;

		vdda-supply = <&pp2800_cam>;
		vdddo-supply = <&pp1800>;
		vddd-supply = <&pp1800>;

		clocks = <&cru SCLK_TESTCLKOUT1>;
		clock-names = "xvclk";

		port {
			sensor_out: endpoint {
				remote-endpoint = <&csiss_in>;
			};
		};
	};
```

## Documentation/devicetree/bindings/media/i2c/ov9281.txt
```
* Omnivision OV9281 CMOS sensor

Required Properties:
- compatible: shall be one of
	"ovti,ov9281"
- clocks: reference to the xvclk input clock.
- clock-names: Must include the following entry: "xvclk"
- avdd-supply: Analog voltage supply
- dovdd-supply: Digital I/O voltage supply
- dvdd-supply: Digital core voltage supply

Optional Properties:
- reset-gpios: reference to the GPIO connected to the resetb pin, if any.
  Active is high.
- pwdn-gpios: reference to the GPIO connected to the pwdn pin, if any.
  Active is high.

The device node shall contain one 'port' child node with one child 'endpoint'
subnode for its digital output video port, in accordance with the video
interface bindings defined in Documentation/devicetree/bindings/media/
video-interfaces.txt.

Example:

&i2c0 {
	ov9281: camera@30 {
		compatible = "ovti,ov9281";
		reg = <0x30>;
		reset-gpios = <&axi_gpio_0 0 GPIO_ACTIVE_HIGH>;
		pwdn-gpios = <&axi_gpio_0 1 GPIO_ACTIVE_HIGH>;

		avdd-supply = <&pp2800_cam>;
		dovdd-supply = <&pp1800>;
		dvdd-supply = <&pp1800>;

		clocks = <&cru SCLK_TESTCLKOUT1>;
		clock-names = "xvclk";

		port {
			ov9281: endpoint {
				remote-endpoint = <&vcap1_in0>;
			};
		};
	};
};
```

## Documentation/devicetree/bindings/media/i2c/vc,mipi-cam.txt
```
* Vision Components GmbH MIPI-CSI cameras

Required Properties:
- compatible: shall be one of
	"vc,mipi-cam"

* Vision Components GmbH MIPI-CSI camera FPGA

Required Properties:
- compatible: shall be one of
	"vc,fpga"
- reg: I2C address

Required child nodes:
- regulator: node of camera supply regulator
- reset: node of camera reset controller
- gpio-chip: node for gpio chip implemented by the fpga

i2c3 {
	vc_fpga: fpga@10 {
		reg = <0x10>;
		compatible = "vc,fpga";
		status = "okay";

		vc_fpga_reg: regulator {
			regulator-name = "CAM_VCC";
		};

		vc_fpga_reset: reset {
			#reset-cells = <0>;
		};

		vc_fpga_gpio: gpio-chip {
			gpio-controller;
			#gpio-cells = <2>;
		};
	};
};
```

## Documentation/devicetree/bindings/misc/nxp,nafe13388.yaml
```yaml
# SPDX-License-Identifier: GPL-2.0-only OR BSD-2-Clause
# Copyright (C) 2022 TQ-Systems GmbH
%YAML 1.2
---
$id: http://devicetree.org/schemas/misc/nxp,nafe13388.yaml#
$schema: http://devicetree.org/meta-schemas/core.yaml#

title: NXP NAFE13388 Analog Frontend

description: |
  The NXP NAFE13388 is an SPI-based analog input frontend which provides
  several analog input channels.

maintainers:
  - Matthias Schiffer <matthias.schiffer@tq-group.com>

properties:
  compatible:
    const: nxp,nafe13388

  reg:
    maxItems: 1

  spi-cpha: true

  spi-max-frequency: true

required:
  - compatible
  - reg
  - spi-cpha

additionalProperties: false

examples:
  - |
    spi {
        #address-cells = <1>;
        #size-cells = <0>;

        adc@0 {
            compatible = "nxp,nafe13388";
            reg = <0>;
            spi-max-frequency = <32000000>;
            spi-cpha;
        };
    };
```

## Documentation/devicetree/bindings/net/ti,dp83867.txt
```
* Texas Instruments - dp83867 Giga bit ethernet phy

Required properties:
	- reg - The ID number for the phy, usually a small integer
	- ti,rx-internal-delay - RGMII Recieve Clock Delay - see dt-bindings/net/ti-dp83867.h
		for applicable values
	- ti,tx-internal-delay - RGMII Transmit Clock Delay - see dt-bindings/net/ti-dp83867.h
		for applicable values
	- ti,fifo-depth - Transmitt FIFO depth- see dt-bindings/net/ti-dp83867.h
		for applicable values
	- ti,led-function - Value for the led function register - see RM dp83867ir.pdf, page 71
	- ti,led-ctrl - Value for the led control register - see RM dp83867ir.pdf, page 73

Optional properties:
	- ti,invert_line_drv - Enable line driver inversion, value: boolean
	- ti,port_mirror - Enable port mirroring, value: boolean

Default child nodes are standard Ethernet PHY device
nodes as described in Documentation/devicetree/bindings/net/phy.txt

Example:

	ethernet-phy@0 {
		reg = <0>;
		ti,rx-internal-delay = <DP83867_RGMIIDCTL_2_25_NS>;
		ti,tx-internal-delay = <DP83867_RGMIIDCTL_2_75_NS>;
		ti,fifo-depth = <DP83867_PHYCR_FIFO_DEPTH_4_B_NIB>;
		ti,led-function = <0x0db0>;	/* LED1: Link/Activity, LED2: error */
		ti,led-ctrl = <0x1001>;		/* active low, LED1/2 driven by phy */
		ti,port_mirror;
	};

Datasheet can be found:
http://www.ti.com/product/DP83867IR/datasheet
```

## Documentation/devicetree/bindings/phy/fsl,imx8mq-usb-phy.txt
```
* Freescale / NXP USB Phy Device for DWC3 USB

Required properties:
- compatible: should contain:
	* "fsl,imx8mq-usb-phy" for imx8mq and imx8mql
- reg: Should contain registers location and length
- #phy-cells: should contain <1>
- clocks: phandle to root clock
- clock-names: should be usb_phy_root_clk

Optional properties:
- vbus-supply: phandle to VBUS regulator that is switched by phy set mode call

Example:
usb3_phy0: phy@381f0040 {
	compatible = "fsl,imx8mq-usb-phy";
	#phy-cells = <1>;
	reg = <0x0 0x381f0040 0x0 0x40>;
	clocks = <&clk IMX8MQ_CLK_USB1_PHY_ROOT>;
	clock-names = "usb_phy_root_clk";
	vbus-supply = <&reg_otg_vbus>;
};
```

## Documentation/devicetree/bindings/rtc/nxp,pcf85063.txt
```
* NXP PCF85063		Tiny Real-Time Clock

Required properties:
- compatible: Should contain "nxp,pcf85063".
- reg: I2C address for chip

Optional properties:
- quartz-load-femtofarads : Internal oscillator capacity for quartz crystals
	Values usable for pcf85063 load capacitance are 7000 fF, 12500 fF
- nxp,offset: raw hex value of offset register.
	if not given, driver will keep current register value

Example:
	pcf85063: rtc@51 {
		compatible = "nxp,pcf85063";
		quartz-load-femtofarads = "7000";
		nxp,offset = <0x80>;
		reg = <0x51>;
	};
```
